## conf/distro/tricorder.conf
```bitbake
# distribution config
DISTRO = "tricorder"
DISTRO_NAME = "tricorder operating system"
DISTRO_VERSION = "${DATE}"

TARGET_VENDOR = "-tricorder"

IMAGE_CLASSES += "bootimg"
IMAGE_FSTYPES ?= "ext4 bootimg"
PACKAGE_CLASSES = "package_deb"

GLIBC_GENERATE_LOCALES = "en_US.UTF-8"
IMAGE_LINGUAS = "en-us"

INITRAMFS_IMAGE_BUNDLE = "1"
INITRAMFS_IMAGE = "tricorder-initramfs"
KERNEL_INITRAMFS = "-initramfs"

require conf/distro/include/distrofeatures.inc
```

## conf/layer.conf
```bitbake
#We have a conf and classes directory, add to BBPATH
BBPATH .= ":${LAYERDIR}"

# We have a recipes-* directories, add to BBFILES
BBFILES += "${LAYERDIR}/recipes-*/*/*.bb \
  ${LAYERDIR}/recipes-*/*/*.bbappend"

BBFILE_COLLECTIONS += "tricorder"
BBFILE_PATTERN_tricorder := "^${LAYERDIR}/"
BBFILE_PRIORITY_tricorder = "6"

LAYERVERSION_tricorder = "1"

LAYERDEPENDS_tricorder = " \
  core \
  openembedded-layer \
  "
```
